const int pin_count = 16;
/////////////////////////////0,1,2,3,4,5,6,7,8 ,9 ,10,11,12,13,14,15
/////////////////////////////A,B,C,D,E,F,G,H,I ,J ,K ,L ,M ,N ,O, P 
const int pins[pin_count] = {2,3,4,5,6,7,8,9,10,11,12,13,A0,A1,A2,A3};  

const int LED_count = 201;

int LOW_POS[] = {
  0, 4, 4, 6, 6, 8, 8, 10, 10, 1,
  4, 0, 6, 4, 8, 6, 10, 8, 12, 10,
  2, 4, 1, 6, 0, 8, 4, 10, 6, 12,
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  7, 2, 11, 15, 9, 11, 7, 9, 5, 7, 3 
  };

int HIGH_POS[] = {
  4, 0, 6, 4, 8, 6, 10, 8, 12, 4,
  1, 6, 0, 8, 4, 10, 6, 12, 8, 13,
  4, 2, 6, 1, 8, 0, 10, 4, 12, 6,
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  3, 5, 15, 11, 11, 9, 9, 7, 7, 5,5
};



void setup() {
  PinReset();
}


int full_grid_brightness = 50; // optimal timing for full grid


void loop() {

  for (int i = 0; i < LED_count; i++) {
    pinMode(pins[LOW_POS[i]], OUTPUT);
    pinMode(pins[HIGH_POS[i]], OUTPUT);

    digitalWrite(pins[LOW_POS[i]],LOW);
    digitalWrite(pins[HIGH_POS[i]],HIGH);

    if (i == 101){
      delayMicroseconds(full_grid_brightness*50);

    }
    else{
      delayMicroseconds(full_grid_brightness);

    }

    pinMode(pins[LOW_POS[i]], INPUT);
    pinMode(pins[HIGH_POS[i]], INPUT);    
  }

}

/////////////////////////// FUNCTIONS ///////////////////////////
void PinReset() {
  /* reset all pins to a count of pin_count
  */   
  for (int i = 0; i < pin_count; i++) {
    pinMode(pins[i], INPUT);
  }
}


